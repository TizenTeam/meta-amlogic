## conf/machine/include/amlogic.inc
```bitbake
MACHINE_ESSENTIAL_EXTRA_RDEPENDS += " ${@bb.utils.contains('MACHINE_FEATURES', 'fb', 'amlsetfb', '', d)}"

PREFERRED_PROVIDER_virtual/libgles1 = "opengl-amlogic"
PREFERRED_PROVIDER_virtual/libgles2 = "opengl-amlogic"
PREFERRED_PROVIDER_virtual/egl = "opengl-amlogic"

PREFERRED_PROVIDER_virtual/kernel = "linux-amlogic"
PREFERRED_PROVIDER_jpeg = "libjpeg-turbo"
PREFERRED_PROVIDER_jpeg-native = "libjpeg-turbo-native"
```

## conf/machine/odroidc1.conf
```bitbake
#@TYPE: Machine
#@NAME: ODROID-C1
#@DESCRIPTION: Machine configuration for the ODROID-C1 by Hardkernel

# Amlogic defaults
require conf/machine/include/amlogic.inc

TARGET_ARCH = "arm"


MACHINE_FEATURES += "alsa usbhost meson-m8"

MACHINE_ESSENTIAL_EXTRA_RRECOMMENDS += " \
        u-boot-ini \
        kernel-devicetree \
"


MACHINE_EXTRA_RRECOMMENDS += " \
    kernel-modules \
    libamcodec \
"

PREFERRED_PROVIDER_virtual/kernel = "linux-hardkernel"

PREFERRED_PROVIDER_virtual/bootloader = "u-boot-odroidc1"
PREFERRED_PROVIDER_u-boot = "u-boot-odroidc1"
PREFERRED_VERSION_u-boot-odroidc1 = "v2011.03%"

UBOOT_MACHINE = "odroidc_config"

KERNEL_DEVICETREE = "meson8b_odroidc.dtb"

KERNEL_IMAGETYPE = "uImage"
IMAGE_CLASSES += "odroidc1-sdimg"
IMAGE_FSTYPES += "tar.gz odroidc1-sdimg"

SERIAL_CONSOLE = "115200 ttyS0"

DEFAULTTUNE ?= "cortexa5hf-neon"
require conf/machine/include/tune-cortexa5.inc
```
